#include "scylla.dtsi"

//&default_transform {
//	col-offset = <6>;
//};

// &skeletyl_transform {
// 	col-offset = <6>;
// };

&kscan0 {
	col-gpios
		= <&gpio1 15 (GPIO_ACTIVE_HIGH)>
		, <&gpio0 02 (GPIO_ACTIVE_HIGH)>
		, <&gpio0 29 (GPIO_ACTIVE_HIGH)>
		, <&gpio0 31 (GPIO_ACTIVE_HIGH)>
		, <&gpio1 06 (GPIO_ACTIVE_HIGH)>
		, <&gpio1 04 (GPIO_ACTIVE_HIGH)>
		;
};
