#include "scylla.dtsi"

&kscan0 {
	col-gpios
		= <&gpio1 04 (GPIO_ACTIVE_HIGH)>
		, <&gpio1 06 (GPIO_ACTIVE_HIGH)>
		, <&gpio0 31 (GPIO_ACTIVE_HIGH)>
		, <&gpio0 29 (GPIO_ACTIVE_HIGH)>
		, <&gpio0  2 (GPIO_ACTIVE_HIGH)>
		, <&gpio1 15 (GPIO_ACTIVE_HIGH)>
		;
};

