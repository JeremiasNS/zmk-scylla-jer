## config/boards/shields/scylla/Kconfig.defconfig
```kconfig
if SHIELD_SCYLLA_LEFT || SHIELD_SCYLLA_RIGHT

config ZMK_KEYBOARD_NAME
    default "ScyllaMK2"

config ZMK_SPLIT_BLE_ROLE_CENTRAL
    default y if SHIELD_SCYLLA_LEFT
    default n if SHIELD_SCYLLA_RIGHT

endif
```
